## sound/soc/davinci/Kconfig
```kconfig
config SND_DAVINCI_SOC
	tristate "SoC Audio for the TI DAVINCI chip"
	depends on ARCH_DAVINCI
	help
	  Say Y or M if you want to add support for codecs attached to
	  the DAVINCI AC97 or I2S interface. You will also need
	  to select the audio interfaces to support below.

config SND_DAVINCI_SOC_I2S
	tristate

config SND_DAVINCI_SOC_MCASP
	tristate

config SND_DAVINCI_SOC_VCIF
	tristate

config SND_DAVINCI_SOC_EVM
	tristate "SoC Audio support for DaVinci DM6446, DM355 or DM365 EVM"
	depends on SND_DAVINCI_SOC
	depends on MACH_DAVINCI_EVM || MACH_DAVINCI_DM355_EVM  || MACH_DAVINCI_DM365_EVM
	select SND_DAVINCI_SOC_I2S
	select SND_SOC_TLV320AIC3X
	help
	  Say Y if you want to add support for SoC audio on TI
	  DaVinci DM6446 or DM355 EVM platforms.

config SND_DAVINCI_SOC_BASI
	tristate "SoC Audio support for DM365 basi board"
	depends on SND_DAVINCI_SOC && MACH_BASI
	select SND_DM365_VOICE_CODEC
	select SND_SOC_CQ0093VC
	select SND_DAVINCI_SOC_VCIF
	help
	  Say Y if you want to add support for SoC audio on
	  Bticino basi board.

config SND_DAVINCI_SOC_DINGO
        tristate "SoC Audio support for DM365 dingo board"
        depends on SND_DAVINCI_SOC && MACH_DINGO
        select SND_DM365_VOICE_CODEC
        select SND_SOC_CQ0093VC
        select SND_DAVINCI_SOC_VCIF
        select SND_DM365_UDA1334_CODEC
        help
          Say Y if you want to add support for SoC audio on
          Bticino dingo board.

config SND_DM365_UDA134X_CODEC
	bool "Audio Codec - UDA134X"
	select SND_DAVINCI_SOC_I2S
	select SND_SOC_UDA134X
	help
	  Say Y if you want to add support for UDA134X audio codec

config SND_DM365_UDA1334_CODEC
	bool "Audio Codec - UDA1334"
	select SND_DAVINCI_SOC_I2S
	select SND_SOC_UDA1334
	help
	  Say Y if you want to add support for UDA1334 audio codec

config SND_DM365_VOICE_CODEC
	bool "Voice Codec - CQ93VC"
	select MFD_DAVINCI_VOICECODEC
	select SND_DAVINCI_SOC_VCIF
	select SND_SOC_CQ0093VC
	help
	  Say Y if you want to add support for SoC On-chip voice codec

config  SND_DM6467_SOC_EVM
	tristate "SoC Audio support for DaVinci DM6467 EVM"
	depends on SND_DAVINCI_SOC && MACH_DAVINCI_DM6467_EVM
	select SND_DAVINCI_SOC_MCASP
	select SND_SOC_TLV320AIC3X
	select SND_SOC_SPDIF

	help
	  Say Y if you want to add support for SoC audio on TI

config SND_DAVINCI_SOC_SFFSDR
	tristate "SoC Audio support for SFFSDR"
	depends on SND_DAVINCI_SOC && MACH_SFFSDR
	select SND_DAVINCI_SOC_I2S
	select SND_SOC_PCM3008
	select SFFSDR_FPGA
	help
	  Say Y if you want to add support for SoC audio on
	  Lyrtech SFFSDR board.

config  SND_DA830_SOC_EVM
	tristate "SoC Audio support for DA830/OMAP-L137 EVM"
	depends on SND_DAVINCI_SOC && MACH_DAVINCI_DA830_EVM
	select SND_DAVINCI_SOC_MCASP
	select SND_SOC_TLV320AIC3X

	help
	  Say Y if you want to add support for SoC audio on TI
	  DA830/OMAP-L137 EVM

config  SND_DA850_SOC_EVM
	tristate "SoC Audio support for DA850/OMAP-L138 EVM"
	depends on SND_DAVINCI_SOC && MACH_DAVINCI_DA850_EVM
	select SND_DAVINCI_SOC_MCASP
	select SND_SOC_TLV320AIC3X
	help
	  Say Y if you want to add support for SoC audio on TI
	  DA850/OMAP-L138 EVM
```
